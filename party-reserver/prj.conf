## CMakeLists.txt
```
cmake_minimum_required(VERSION 3.20.0)

find_package(Zephyr REQUIRED HINTS $ENV{ZEPHYR_BASE})

project(party-reserver C)

file(GLOB SRC
    "src/*.c"
)

target_sources(app PRIVATE ${SRC})

zephyr_include_directories(include)
```

## Kconfig
```
mainmenu "Party reserver"

source "Kconfig.zephyr"

menu "Application options"

choice DEVICE_ROLE
    prompt "Device role"
    default BUTTON_SENDER
    help
        Select whether this device is a physical reservation
        button or a reservations gateway.

config BUTTON_SENDER
    bool "Reservation button"

config RECEIVER
    bool "Reservation receiver"

endchoice

config ESPNOW_BEACON_INTERVAL_S
    int "ESP-NOW beacon interval"
    default 5
    help
        Heartbeat beacon interval (in seconds).

config APP_ESPNOW_CHANNEL
    int "ESP-NOW Wi-Fi channel"
    range 1 13
    default 1
    help
        Both senders and receiver devices must use the same channel.
        
endmenu
```

## prj.conf
```kconfig
# GPIO is needed for the sender button.
CONFIG_GPIO=y

# Threads
CONFIG_MULTITHREADING=y

# Enable Zephyr networking and the ESP32 Wi-Fi driver.
CONFIG_NETWORKING=y
CONFIG_WIFI=y
CONFIG_NET_L2_WIFI_MGMT=y

# Logging through the USB serial console.
CONFIG_BOOT_BANNER=n
CONFIG_LOG=n
CONFIG_SERIAL=y
CONFIG_CONSOLE=n
CONFIG_PRINTK=n
CONFIG_LOG_DEFAULT_LEVEL=3
CONFIG_WIFI_LOG_LEVEL_ERR=y

# Give the Wi-Fi driver sufficient memory.
CONFIG_MAIN_STACK_SIZE=4096
CONFIG_HEAP_MEM_POOL_SIZE=65536

# CUSTOM SETTINGS - EDIT BEFORE BUILD
# CONFIG_BUTTON_SENDER=y 
CONFIG_RECEIVER=y
CONFIG_APP_ESPNOW_CHANNEL=1
```

## boards/app.overlay
```dts
/ {
	buttons {
		compatible = "gpio-keys";

		button0: button_0 {
			gpios = <&gpio0 2 (GPIO_PULL_UP | GPIO_ACTIVE_LOW)>;
			label = "Reservation button";
			zephyr,code = <INPUT_KEY_0>;
		};
	};

	aliases {
		// Aliases
		reservationbutton = &button0;
	};
};
```

## src/main.c
```c
#include <zephyr/kernel.h>
#include <zephyr/logging/log.h>
#include <zephyr/drivers/gpio.h>
#include <zephyr/drivers/uart.h>
#include <inttypes.h>
#include <string.h>

#include <esp_now.h>
#include <esp_wifi.h>

#include <button.h>
#include <esp_now_button.h>

LOG_MODULE_REGISTER(party_reserver, LOG_LEVEL_INF);

// IO specs
static const struct gpio_dt_spec user_led = GPIO_DT_SPEC_GET(DT_ALIAS(led0), gpios);
static const struct gpio_dt_spec reservation_button = GPIO_DT_SPEC_GET(DT_ALIAS(reservationbutton), gpios);

static const struct device *const serial_dev = DEVICE_DT_GET(DT_CHOSEN(zephyr_console));

static int serial_write_line(const char *data, size_t len)
{
	if (!device_is_ready(serial_dev))
	{
		return -ENODEV;
	}

	for (size_t i = 0; i < len; ++i)
	{
		uart_poll_out(serial_dev, (unsigned char)data[i]);
	}

	return 0;
}

#define RX_MAX_PAYLOAD_SIZE 9 // Heatboar has the Header (1 byte) and 2*4bytes of data

#define RX_QUEUE_DEPTH 50

struct received_packet
{
	// Header
	enum espnow_message_type type;

	// metadata
	uint8_t src_mac[ESP_NOW_ETH_ALEN];
	uint32_t received_at_ms;

	// Actual data
	uint8_t data[RX_MAX_PAYLOAD_SIZE];
};

K_MSGQ_DEFINE(rx_queue, sizeof(struct received_packet), RX_QUEUE_DEPTH, 4);

/* Loggin received data */
void receiver_recv_cb(const esp_now_recv_info_t *info, const uint8_t *data, int len)
{
	recv_log_cb(info, data, len);

	if (!info || !data || len <= 0)
	{
		return;
	}

	if (len < ESPNOW_HEADER_SIZE || len > RX_MAX_PAYLOAD_SIZE)
	{
		return;
	}

	struct received_packet packet = {0};

	memcpy(packet.src_mac, info->src_addr, sizeof(packet.src_mac));

	// The first byte is the Header->type field
	packet.type = (enum espnow_message_type)data[0];
	memcpy(packet.data, data + ESPNOW_HEADER_SIZE, (size_t)len - ESPNOW_HEADER_SIZE);

	packet.received_at_ms = k_uptime_get_32();

	if (k_msgq_put(&rx_queue, &packet, K_NO_WAIT) != 0)
	{
		// atomic_inc(&rx_dropped);
	}
}

static void process_packet(const struct received_packet *packet)
{
	char line[192];
	char mac[18];

	snprintf(mac, sizeof(mac),
			 "%02x:%02x:%02x:%02x:%02x:%02x",
			 (unsigned)packet->src_mac[0],
			 (unsigned)packet->src_mac[1],
			 (unsigned)packet->src_mac[2],
			 (unsigned)packet->src_mac[3],
			 (unsigned)packet->src_mac[4],
			 (unsigned)packet->src_mac[5]);

	int len;

	switch (packet->type)
	{
	case ESPNOW_MSG_BUTTON:
	{
		uint8_t state = packet->data[0];

		if (state != RELEASED && state != PRESSED)
		{
			return;
		}

		len = snprintf(
			line, sizeof(line),
			"{\"type\":\"button\",\"mac\":\"%s\","
			"\"state\":%u,\"received_at_ms\":%" PRIu32 "}\n",
			mac,
			(unsigned)state,
			packet->received_at_ms);
		break;
	}

	case ESPNOW_MSG_HEARTBEAT:
	{
		uint32_t sequence = sys_get_le32(&packet->data[0]);
		uint32_t uptime_ms = sys_get_le32(&packet->data[4]);

		len = snprintf(
			line, sizeof(line),
			"{\"type\":\"heartbeat\",\"mac\":\"%s\","
			"\"seq\":%" PRIu32 ",\"uptime_ms\":%" PRIu32 ","
			"\"received_at_ms\":%" PRIu32 "}\n",
			mac,
			sequence,
			uptime_ms,
			packet->received_at_ms);
		break;
	}

	default:
		return;
	}

	/* Never transmit truncated JSON. */
	if (len < 0 || (size_t)len >= sizeof(line))
	{
		return;
	}

	int ret = serial_write_line(line, (size_t)len);
	if (ret < 0)
	{
		/* Record a failure counter if needed; logs are disabled. */
	}
}

K_THREAD_STACK_DEFINE(s_receiver_stack, BEACON_THREAD_STACK_SIZE);
struct k_thread s_receiver_tid;

static void receiver_thread(void *arg1, void *arg2, void *arg3)
{
	ARG_UNUSED(arg1);
	ARG_UNUSED(arg2);
	ARG_UNUSED(arg3);

	struct received_packet packet;

	while (true)
	{
		if (k_msgq_get(&rx_queue, &packet, K_FOREVER) == 0)
		{
			process_packet(&packet);
		}
	}
}

/*
 * Sender-only callback, on button state changes, broadcasts the updated state.
 */
void on_button_change_cb(enum button_state state)
{
	// For debug purses we sync the board LED with the button state
	gpio_pin_set_dt(&user_led, state == RELEASED ? 0 : 1);

	const uint8_t payload[2] = {
		(uint8_t)ESPNOW_MSG_BUTTON,
		(uint8_t)state,
	};

	int err = esp_now_send(bcast_mac, payload, sizeof(payload));

	if (err != ESP_OK)
	{
		LOG_ERR("esp_now_send failed: 0x%x", err);
	}

	return;
}

int main()
{
	// global return status code
	int ret;

	k_msleep(1000);

	// Common ESP-NOW initialization
	ret = esp_now_button_init();

	if (ret != 0)
	{
		LOG_ERR("ESP-NOW initialization failed");
		return ret;
	}

	// GPIO setup
	if (!gpio_is_ready_dt(&user_led))
	{
		return -EIO;
	}

	ret = gpio_pin_configure_dt(&user_led, GPIO_OUTPUT_ACTIVE);

	if (ret < 0)
	{
		LOG_ERR("User LED configuration failed");
		return ret;
	}

	if (IS_ENABLED(CONFIG_BUTTON_SENDER))
	{
		if (!gpio_is_ready_dt(&reservation_button))
		{
			return -EIO;
		}

		ret = gpio_pin_configure_dt(&reservation_button, GPIO_INPUT | GPIO_PULL_UP);

		if (ret != 0)
		{
			LOG_ERR("Reservation button configuration failed");
			return ret;
		}
	}

	// Loggin for sent payloads via ESP-NOW is enabled for both device modes
	int esp_err = esp_now_register_send_cb(send_log_cb);
	if (esp_err != ESP_OK)
	{
		LOG_ERR("esp_now_register_send_cb failed: 0x%x", esp_err);
		return -EIO;
	}

	if (IS_ENABLED(CONFIG_BUTTON_SENDER))
	{
		// ESP-NOW loggin callbacks
		esp_err = esp_now_register_recv_cb(recv_log_cb);
		if (esp_err != ESP_OK)
		{
			LOG_ERR("esp_now_register_recv_cb failed: 0x%x", esp_err);
			return -EIO;
		}

		// Button-side ESP32 board
		// Here we want to broadcast the button state
		ret = register_button(&reservation_button, &on_button_change_cb);

		on_button_change_cb(RELEASED);

		// Start the heartbeat thread
		k_thread_create(&s_beacon_tid, s_beacon_stack, K_THREAD_STACK_SIZEOF(s_beacon_stack), &beacon_thread, NULL, NULL, NULL, BEACON_THREAD_PRIORITY, 0, K_NO_WAIT);
		LOG_INF("Beacon thread started, interval=%ds", CONFIG_ESPNOW_BEACON_INTERVAL_S);
	}
	else if (IS_ENABLED(CONFIG_RECEIVER))
	{
		if (!device_is_ready(serial_dev))
		{
			return -ENODEV;
		}

		// ESP-NOW loggin callbacks
		esp_err = esp_now_register_recv_cb(receiver_recv_cb);
		if (esp_err != ESP_OK)
		{
			LOG_ERR("esp_now_register_recv_cb failed: 0x%x", esp_err);
			return -EIO;
		}

		k_thread_create(&s_receiver_tid, s_receiver_stack, K_THREAD_STACK_SIZEOF(s_receiver_stack), &receiver_thread, NULL, NULL, NULL, BEACON_THREAD_PRIORITY, 0, K_NO_WAIT);
		LOG_INF("Receiver thread started");
	}

	while (1)
	{
		k_msleep(1000);
	}

	return 0;
}
```

## include/button.h
```c
#ifndef _BUTTON_H_
#define _BUTTON_H_

#include <zephyr/kernel.h>
#include <zephyr/logging/log.h>
#include <zephyr/drivers/gpio.h>
#include <inttypes.h>
#include <string.h>

#include <esp_now.h>
#include <esp_wifi.h>

enum button_state {
    RELEASED = 0,
    PRESSED = 1
};

typedef void (*button_callback_t)(enum button_state _state);

int register_button(struct gpio_dt_spec* button_dt_spec, button_callback_t on_state_change_cb);

#endif
```

## include/esp_now_button.h
```c
#ifndef _ESP_NOW_BUTTON_H_
#define _ESP_NOW_BUTTON_H_

#include <zephyr/kernel.h>
#include <zephyr/logging/log.h>
#include <zephyr/drivers/gpio.h>
#include <zephyr/sys/byteorder.h>
#include <inttypes.h>
#include <string.h>

#include <esp_now.h>
#include <esp_wifi.h>

#include "button.h"

// Beacon thread settings
#define BEACON_THREAD_STACK_SIZE 2048
#define BEACON_THREAD_PRIORITY   5

K_THREAD_STACK_DECLARE(s_beacon_stack, BEACON_THREAD_STACK_SIZE);
extern struct k_thread s_beacon_tid;

void beacon_thread(void *p1, void *p2, void *p3);

/*
 * ESP-NOW broadcast MAC address
 */
static const uint8_t bcast_mac[ESP_NOW_ETH_ALEN] = {0xFF, 0xFF, 0xFF, 0xFF, 0xFF, 0xFF};

extern uint8_t curr_mac_addr[ESP_NOW_ETH_ALEN];


enum espnow_message_type {
	ESPNOW_MSG_HEARTBEAT = 1,
    ESPNOW_MSG_BUTTON    = 2,
};

#define ESPNOW_HEADER_SIZE 1

/*
 * Heartbeat frame, fixed-layout, 14 bytes on the wire. seq and uptime_ms use little-endian (native ESP32).
 */
struct __packed espnow_button_heartbeat {
	// Header
	uint8_t type;

	// data
	uint32_t seq;
	uint32_t uptime_ms;
};

/*
 * Button state frame 
 */
struct __packed espnow_button_state {
	// Header
	uint8_t type;

	// data
	enum button_state state;
};

void recv_log_cb(const esp_now_recv_info_t *info, const uint8_t *data, int len);

void send_log_cb(const esp_now_send_info_t *tx_info, esp_now_send_status_t status);

esp_err_t esp_now_button_init();

#endif
```

## src/button.c
```c
#include <button.h>

LOG_MODULE_REGISTER(button, LOG_LEVEL_DBG);

static enum button_state current_button_state = RELEASED;

static struct gpio_callback button_cb_data;

static struct gpio_dt_spec* _button_dt_spec;
static button_callback_t _on_state_change_cb;

int debounce_timeout = 30;


static void debounce_button(struct k_work* work){
	int value = gpio_pin_get_dt(_button_dt_spec);
    if (value < 0) {
        LOG_DBG("Cannot read button: %d\n", value);
        return;
    }

    enum button_state new_state = value ? PRESSED : RELEASED;

    if (new_state != current_button_state) {
        current_button_state = new_state;
        LOG_DBG("Reservation button state: %d\n", (int)new_state);

        if (_on_state_change_cb != NULL) {
            _on_state_change_cb(current_button_state);
        }
    }
}

static K_WORK_DELAYABLE_DEFINE(debounce_work, debounce_button);


void button_event_handler(const struct device *dev, struct gpio_callback *cb, uint32_t pins){
	// LOG_DBG("Button event at %" PRIu32 "\n", k_cycle_get_32());
	k_work_reschedule(&debounce_work, K_MSEC(debounce_timeout));
}

int register_button(struct gpio_dt_spec* button_dt_spec, button_callback_t on_state_change_cb) {

    _button_dt_spec = button_dt_spec;
    _on_state_change_cb = on_state_change_cb;

    int ret = gpio_pin_interrupt_configure_dt(button_dt_spec, GPIO_INT_EDGE_BOTH);
    gpio_init_callback(&button_cb_data,  button_event_handler, BIT(button_dt_spec->pin));
    
    return ret | gpio_add_callback(button_dt_spec->port, &button_cb_data);
}
```

## src/esp_now_button.c
```c
#include "esp_now_button.h"

LOG_MODULE_REGISTER(esp_now_button, LOG_LEVEL_INF);

// Beacon thread
K_THREAD_STACK_DEFINE(s_beacon_stack, BEACON_THREAD_STACK_SIZE);
struct k_thread s_beacon_tid;

uint8_t curr_mac_addr[ESP_NOW_ETH_ALEN] = {0};

// ESP-NOW broadcast peer
esp_now_peer_info_t peer = {};


/* Loggin received data */
void recv_log_cb(const esp_now_recv_info_t *info, const uint8_t *data, int len)
{
	if (!info || !data || len <= 0) {
		return;
	}

	const uint8_t *mac = info->src_addr;
	const uint8_t *dst = info->des_addr;
	int8_t rssi = info->rx_ctrl->rssi;
	bool bcast = (memcmp(dst, bcast_mac, ESP_NOW_ETH_ALEN) == 0);

	LOG_INF("RX [%s] from %02x:%02x:%02x:%02x:%02x:%02x  rssi=%d  len=%d", bcast ? "BCAST" : "UNICAST", mac[0], mac[1], mac[2], mac[3], mac[4], mac[5], rssi, len);
	
    LOG_HEXDUMP_INF(data, MIN(len, 32), "  payload:");
}

/* Loggin sent data */
void send_log_cb(const esp_now_send_info_t *tx_info, esp_now_send_status_t status)
{
	if (!tx_info) {
		return;
	}

	const uint8_t *mac = tx_info->des_addr;

	if (status == ESP_NOW_SEND_SUCCESS) {
		LOG_INF("TX OK -> %02x:%02x:%02x:%02x:%02x:%02x, len=%u", mac[0], mac[1], mac[2], mac[3], mac[4], mac[5], tx_info->data_len);
	} else {
		LOG_ERR("TX FAIL-> %02x:%02x:%02x:%02x:%02x:%02x, len=%u", mac[0], mac[1], mac[2], mac[3], mac[4], mac[5], tx_info->data_len);
	}
}

/*
 * Beacon thread.
 * 
 * Sends a heartbeat broadcast every BEACON_INTERVAL_S.
 */
void beacon_thread(void *p1, void *p2, void *p3)
{
	ARG_UNUSED(p1);
	ARG_UNUSED(p2);
	ARG_UNUSED(p3);
	k_thread_name_set(k_current_get(), "beacon");

	uint32_t seq = 0;
	esp_err_t err;

	while (true) {
		seq = seq + 1;

		uint8_t payload[9];

		payload[0] = (uint8_t)ESPNOW_MSG_HEARTBEAT;
		sys_put_le32(seq, &payload[1]);
		sys_put_le32(k_uptime_get_32(), &payload[5]);

		esp_err_t err = esp_now_send(bcast_mac, payload, sizeof(payload));

		if (err != ESP_OK) {
			LOG_ERR("esp_now_send failed: 0x%x", err);
		}

		k_sleep(K_SECONDS(CONFIG_ESPNOW_BEACON_INTERVAL_S));
	}
}

esp_err_t esp_now_button_init() {
	esp_err_t rc;
	wifi_mode_t cur_mode;
	wifi_init_config_t cfg = WIFI_INIT_CONFIG_DEFAULT();

	rc = esp_wifi_get_mode(&cur_mode);

	if (rc == ESP_ERR_WIFI_NOT_INIT) {
		rc = esp_wifi_init(&cfg);
		if (rc != ESP_OK) {
			LOG_ERR("esp_wifi_init failed: 0x%x", rc);
			return -EIO;
		}
	}
	rc = esp_wifi_set_storage(WIFI_STORAGE_RAM);
	if (rc != ESP_OK) {
		LOG_ERR("esp_wifi_set_storage failed: 0x%x", rc);
		return -EIO;
	}
	rc = esp_wifi_set_mode(ESP32_WIFI_MODE_STA);
	if (rc != ESP_OK) {
		LOG_ERR("esp_wifi_set_mode failed: 0x%x", rc);
		return -EIO;
	}
	rc = esp_wifi_start();
	if (rc != ESP_OK) {
		LOG_ERR("esp_wifi_start failed: 0x%x", rc);
		return -EIO;
	}

	// Disable power saving
	rc = esp_wifi_set_ps(WIFI_PS_NONE);
	if (rc != ESP_OK) {
		LOG_ERR("esp_wifi_set_ps failed: 0x%x", (unsigned)rc);
		return rc;
	}

	/* 2. Lock to configured channel -- no AP needed */
	rc = esp_wifi_set_channel(CONFIG_APP_ESPNOW_CHANNEL, WIFI_SECOND_CHAN_NONE);
	if (rc != ESP_OK) {
		LOG_ERR("esp_wifi_set_channel failed: 0x%x", rc);
		return -EIO;
	}

	/* 3. ESP-NOW init + callbacks */
	rc = esp_now_init();
	if (rc != ESP_OK) {
		LOG_ERR("esp_now_init failed: 0x%x", rc);
		return -EIO;
	}

	memcpy(peer.peer_addr, bcast_mac, ESP_NOW_ETH_ALEN);
	peer.channel = CONFIG_APP_ESPNOW_CHANNEL;
	peer.ifidx = WIFI_IF_STA;
	peer.encrypt = false;

	rc = esp_now_add_peer(&peer);
	if (rc != ESP_OK) {
		LOG_ERR("esp_now_add_peer failed: 0x%x", rc);
		return -EIO;
	}

	uint32_t espnow_ver = 0;

	rc = esp_now_get_version(&espnow_ver);
	if (rc != ESP_OK) {
		LOG_ERR("esp_now_get_version failed: 0x%x", rc);
		return -EIO;
	}
	
	rc = esp_wifi_get_mac(WIFI_IF_STA, curr_mac_addr);
	if (rc != ESP_OK) {
		LOG_ERR("esp_wifi_get_mac failed: 0x%x", rc);
		return -EIO;
	}

	LOG_INF("ESP-NOW v%u ready  ch=%u", (unsigned int)espnow_ver, CONFIG_APP_ESPNOW_CHANNEL);
	
	return rc;
}
```
